## boards/st/stm32mp257f_dk/board.yml
```yaml
board:
  name: stm32mp257f_dk
  full_name: STM32MP257F-DK Evaluation Board
  vendor: st
  socs:
    - name: stm32mp257fxx
```

## samples/drivers/can/babbling/config_default/Kconfig/arch/Kconfig
```kconfig
# Load Zephyr Arch Kconfig descriptions.
osource "/home/morealf/zephyrproject/zephyr/arch/rx/Kconfig"
osource "/home/morealf/zephyrproject/zephyr/arch/x86/Kconfig"
osource "/home/morealf/zephyrproject/zephyr/arch/xtensa/Kconfig"
osource "/home/morealf/zephyrproject/zephyr/arch/sparc/Kconfig"
osource "/home/morealf/zephyrproject/zephyr/arch/riscv/Kconfig"
osource "/home/morealf/zephyrproject/zephyr/arch/posix/Kconfig"
osource "/home/morealf/zephyrproject/zephyr/arch/nios2/Kconfig"
osource "/home/morealf/zephyrproject/zephyr/arch/mips/Kconfig"
osource "/home/morealf/zephyrproject/zephyr/arch/arm64/Kconfig"
osource "/home/morealf/zephyrproject/zephyr/arch/arm/Kconfig"
osource "/home/morealf/zephyrproject/zephyr/arch/arc/Kconfig"
```

## samples/drivers/can/babbling/config_default/Kconfig/boards/Kconfig
```kconfig
# Load Zephyr board Kconfig descriptions.
osource "/home/morealf/zephyrproject/zephyr/boards/st/nucleo_h753zi/Kconfig"
```

## samples/drivers/can/babbling/config_default/Kconfig/boards/Kconfig.defconfig
```kconfig
# Load Zephyr board defconfig descriptions.
osource "/home/morealf/zephyrproject/zephyr/boards/st/nucleo_h753zi/Kconfig.defconfig"
```

## samples/drivers/can/babbling/config_default/Kconfig/boards/Kconfig.nucleo_h753zi
```kconfig
# Load board Kconfig descriptions.
osource "/home/morealf/zephyrproject/zephyr/boards/st/nucleo_h753zi/Kconfig.nucleo_h753zi"
```

## samples/drivers/can/babbling/config_default/Kconfig/boards/Kconfig.sysbuild
```kconfig
# Load Sysbuild board Kconfig descriptions.
osource "/home/morealf/zephyrproject/zephyr/boards/st/nucleo_h753zi/Kconfig.sysbuild"
```
